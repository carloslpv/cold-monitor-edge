## firmware/main/Kconfig.projbuild
```kconfig
menu "cold-monitor edge"

    choice CM_NETWORK
        prompt "Network"
        default CM_NETWORK_WIFI

        config CM_NETWORK_WIFI
            bool "Wi-Fi"

        config CM_NETWORK_QEMU
            bool "Emulated Ethernet (QEMU)"
            select ETH_USE_OPENETH
            help
                For running the firmware in the ESP-IDF QEMU emulator, which has no Wi-Fi. Does not work on a board.
    endchoice

    config CM_WIFI_SSID
        string "Wi-Fi SSID"
        default "my-network"

    config CM_WIFI_PASSWORD
        string "Wi-Fi password"
        default ""

    config CM_MQTT_BROKER_URI
        string "MQTT broker URI"
        default "mqtt://192.168.0.10:1883"
        help
            mqtt:// for plain TCP on a local network, mqtts:// when the broker is reachable over the internet.

    config CM_MQTT_USERNAME
        string "MQTT user name"
        default ""
        help
            Leave empty to log in with the device id, which is what the broker ACL in mosquitto/acl expects.

    config CM_MQTT_PASSWORD
        string "MQTT password"
        default ""

    config CM_DEVICE_ID
        string "Device id"
        default ""
        help
            Name used in the MQTT topics (coldmonitor/<device id>/...). Leave empty to use cm-<last three bytes of
            the Wi-Fi MAC address>, which is unique per board.

    config CM_ONEWIRE_GPIO
        int "GPIO of the 1-Wire bus (DS18B20 data line)"
        default 4

    config CM_SIMULATED_PROBES
        bool "Simulated probes"
        default n
        help
            Replaces the GPIO with a simulated 1-Wire bus holding two DS18B20 probes, a fridge around 5 °C and a
            freezer around -25 °C. The search, driver and outbox run unchanged; only the wire is fake. For the
            emulator, or for trying the firmware on a board without probes.

    config CM_DS18B20_RESOLUTION
        int "DS18B20 resolution (bits)"
        range 9 12
        default 12
        help
            12 bits: steps of 0.0625 °C and 750 ms per conversion. 9 bits: steps of 0.5 °C and 94 ms.

    config CM_READ_INTERVAL_S
        int "Seconds between readings"
        range 5 3600
        default 60
        help
            Can be changed at run time with a retained message on coldmonitor/<device id>/config.

    config CM_OUTBOX_CAPACITY
        int "Readings kept while offline"
        range 16 4096
        default 720
        help
            With one probe and one reading per minute, 720 readings cover 12 hours without network. Each reading
            takes 48 bytes of RAM.

    config CM_MAX_INFLIGHT
        int "Readings published and not yet acknowledged"
        range 1 32
        default 8

    config CM_NTP_SERVER
        string "NTP server"
        default "pool.ntp.org"

endmenu
```
